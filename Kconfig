## Kconfig
```kconfig
config USR_LIB_MASSSTORAGE
  bool  "userspace libmassstorage for USB stack"
  default y
  select USR_DRV_SDIO
  select USR_LIB_USBCTRL
  ---help---
  Support for Mass-Storage class (USB_MSC) for USB stack.

if USR_LIB_MASSSTORAGE

menu "SCSI options"

config USR_LIB_MASSSTORAGE_SCSI_DEBUG
  int "SCSI stack debug informations level"
  default 0
  range 0 2
  ---help---
  SCSI stack debug level. Supported levels are:
    * 0: no debug
    * 1: command execution debug, list received and sent commands
    * 2: command dump debug, dumping complex commands content and
         received and sent data size

config USR_LIB_MASSSTORAGE_BBB_DEBUG
  int "BBB stack debug informations level"
  default 0
  range 0 1
  ---help---
  BBB stack debug level. Supported levels are:
    * 0: no debug
    * 1: command execution debug, list received and sent commands


config USR_LIB_MASSSTORAGE_SCSI_MAX_LUNS
  int "Max number of SCSI luns supported"
  default 1
  range 1 15
  ---help---
  Max number of LUNs (Logical Units) supported by the SCSI device.
  For usual USB mass storage devices, this number is 1, but can be set to more than
  1 when handling more complex SCSI devices.

endmenu


endif
```
